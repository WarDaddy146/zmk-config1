/*
 * Copyright (c) 2020 Pete Johanson
 *
 * SPDX-License-Identifier: MIT
 */

#include "corne.dtsi"

&kscan0 {
    diode-direction = "row2col";
    row-gpios = <&pro_micro 9 GPIO_ACTIVE_HIGH>;
    col-gpios = <&pro_micro 16 (GPIO_ACTIVE_HIGH | GPIO_PULL_DOWN)>;
};
&default_transform {
    rows = <1>;
    columns = <1>;
    map = <RC(0,0)>;
};
